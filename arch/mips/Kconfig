## configs/tplatforms_azure_defconfig
```kconfig
CONFIG_MIPS=y
CONFIG_SYS_MALLOC_F_LEN=0x800
CONFIG_NR_DRAM_BANKS=1
CONFIG_DEBUG_UART_BASE=0xBF04A000
CONFIG_DEBUG_UART_CLOCK=7350000
CONFIG_IDENT_STRING=" azure"
CONFIG_TARGET_BAIKAL_MIPS=y
CONFIG_BOARD_TP_RT1MB=y
# CONFIG_DDR_CUSTOM_CLK=1333
CONFIG_CUSTOM_SPD=y
CONFIG_CUSTOM_SPD_FILE="MT41K512M16-x3"
CONFIG_MIPS_CACHE_INDEX_BASE=0x0
# CONFIG_MIPS_BOOT_CMDLINE_LEGACY is not set
# CONFIG_MIPS_BOOT_ENV_LEGACY is not set
CONFIG_MIPS_BOOT_FDT=y
CONFIG_DEBUG_UART=y
CONFIG_AHCI=y
CONFIG_FIT=y
CONFIG_OF_BOARD_SETUP=y
CONFIG_BOOTDELAY=3
CONFIG_CONSOLE_MUX=y
CONFIG_DEFAULT_FDT_FILE="tplatforms_rt1mb.dtb"
CONFIG_BOARD_LATE_INIT=y
CONFIG_BOARD_EARLY_INIT_R=y
CONFIG_HUSH_PARSER=y
CONFIG_SYS_PROMPT="BAIKAL # "
CONFIG_CMD_BOOTMENU=y
CONFIG_CMD_ENV_CALLBACK=y
CONFIG_CMD_ENV_FLAGS=y
CONFIG_CMD_CLK=y
CONFIG_CMD_DM=y
CONFIG_CMD_GPIO=y
CONFIG_CMD_I2C=y
CONFIG_CMD_MTD=y
CONFIG_CMD_PART=y
CONFIG_CMD_PCI=y
CONFIG_CMD_SF=y
CONFIG_CMD_USB=y
CONFIG_CMD_DHCP=y
CONFIG_CMD_PING=y
CONFIG_CMD_EXT2=y
CONFIG_CMD_EXT4=y
CONFIG_CMD_FAT=y
CONFIG_CMD_FS_GENERIC=y
CONFIG_CMD_MTDPARTS=y
CONFIG_EFI_PARTITION=y
CONFIG_OF_CONTROL=y
CONFIG_DEFAULT_DEVICE_TREE="tplatforms_rt1mb"
CONFIG_ENV_IS_IN_SPI_FLASH=y
CONFIG_DM=y
CONFIG_DWC_AHCI=y
CONFIG_CLK=y
CONFIG_CLK_BAIKAL=y
CONFIG_DM_GPIO=y
CONFIG_DWAPB_GPIO=y
CONFIG_DWMAC_GPIO=y
CONFIG_DM_I2C=y
CONFIG_SYS_I2C_DW=y
CONFIG_DM_KEYBOARD=y
CONFIG_MISC=y
CONFIG_I2C_EEPROM=y
CONFIG_MMC=y
CONFIG_DM_MMC=y
CONFIG_MMC_SPI=y
CONFIG_MTD=y
CONFIG_DM_SPI_FLASH=y
CONFIG_SPI_FLASH=y
CONFIG_SF_DEFAULT_BUS=2
CONFIG_SF_DEFAULT_SPEED=25000000
CONFIG_SPI_FLASH_SPANSION=y
CONFIG_SPI_FLASH_STMICRO=y
CONFIG_SPI_FLASH_WINBOND=y
CONFIG_SPI_FLASH_MTD=y
CONFIG_PHY_MARVELL=y
CONFIG_DM_ETH=y
CONFIG_ETH_DESIGNWARE=y
CONFIG_PCI=y
CONFIG_DM_PCI=y
CONFIG_PCIE_DW=y
CONFIG_NOP_PHY=y
CONFIG_SCSI=y
CONFIG_DM_SCSI=y
CONFIG_SPECIFY_CONSOLE_INDEX=y
CONFIG_DM_SERIAL=y
CONFIG_SERIAL_RX_BUFFER=y
CONFIG_DEBUG_UART_SHIFT=2
CONFIG_SYS_NS16550=y
CONFIG_SPI=y
CONFIG_DM_SPI=y
CONFIG_DESIGNWARE_SPI=y
CONFIG_USB=y
CONFIG_DM_USB=y
CONFIG_USB_XHCI_HCD=y
CONFIG_USB_XHCI_DWC3=y
CONFIG_USB_DWC3=y
CONFIG_USB_STORAGE=y
CONFIG_USB_KEYBOARD=y
CONFIG_WDT=y
CONFIG_WDT_DESIGNWARE=y
```

## configs/tplatforms_bn1bt1_defconfig
```kconfig
CONFIG_SYS_EXTRA_OPTIONS="SYS_LITTLE_ENDIAN"
CONFIG_MIPS=y
CONFIG_SYS_CONFIG_NAME="tplatforms_bn1bt1"
CONFIG_TARGET_BAIKAL_MIPS=y
CONFIG_TPLATFORMS_BN1BT1=y
CONFIG_BAIKAL_T1=y
CONFIG_TUNE_P5600=y
CONFIG_USE_HARD_FLOAT=y
```

## configs/tplatforms_em406-b_defconfig
```kconfig
CONFIG_DEFCONFIG_LIST="configs/sandbox_defconfig"
CONFIG_SYS_EXTRA_OPTIONS="SYS_LITTLE_ENDIAN"
CONFIG_MIPS=y
CONFIG_SYS_ARCH="mips"
CONFIG_SYS_CPU="mips32"
CONFIG_SYS_BOARD="mips"
CONFIG_SYS_VENDOR="baikal"
CONFIG_SYS_CONFIG_NAME="tplatforms_msbt2"
CONFIG_TARGET_BAIKAL_MIPS=y
CONFIG_TPLATFORMS_MSBT2=y
CONFIG_BAIKAL_T1=y
CONFIG_TUNE_P5600=y
CONFIG_USE_HARD_FLOAT=y
CONFIG_DISPLAY_CPUINFO=y
CONFIG_DISPLAY_BOARDINFO=y
CONFIG_AUTO_COMPLETE=y
CONFIG_CMDLINE_EDITING=y
CONFIG_CMD_ENV=y
CONFIG_ENV_OVERWRITE=y
CONFIG_CMD_GO=y
CONFIG_CMD_SAVES=y
CONFIG_CMD_CRC32=y
CONFIG_SERIAL=y
CONFIG_CONS_INDEX=1
CONFIG_BAUDRATE=115200
CONFIG_CUSTOM_SPD=y
CONFIG_CUSTOM_SPD_FILE="AS4C1G8D3LA_1066"
```

## configs/tplatforms_mitx_defconfig
```kconfig
CONFIG_SYS_EXTRA_OPTIONS="SYS_LITTLE_ENDIAN"
CONFIG_MIPS=y
CONFIG_SYS_ARCH="mips"
CONFIG_SYS_CPU="mips32"
CONFIG_SYS_BOARD="mips"
CONFIG_SYS_VENDOR="baikal"
CONFIG_SYS_CONFIG_NAME="tplatforms_mitx"
CONFIG_TARGET_BAIKAL_MIPS=y
CONFIG_TPLATFORMS_MITX=y
CONFIG_BAIKAL_T1=y
CONFIG_TUNE_P5600=y
CONFIG_USE_HARD_FLOAT=y
```

## configs/tplatforms_mrbt1_defconfig
```kconfig
CONFIG_MIPS=y
CONFIG_SYS_MALLOC_F_LEN=0x800
CONFIG_NR_DRAM_BANKS=1
CONFIG_DEBUG_UART_BASE=0xBF04A000
CONFIG_DEBUG_UART_CLOCK=7350000
CONFIG_IDENT_STRING=" mrbt1"
CONFIG_TARGET_BAIKAL_MIPS=y
CONFIG_BOARD_TP_MRBT1=y
CONFIG_CUSTOM_SPD=y
CONFIG_CUSTOM_SPD_FILE="MT41K1G8-2"
CONFIG_MIPS_CACHE_INDEX_BASE=0x0
# CONFIG_MIPS_BOOT_CMDLINE_LEGACY is not set
# CONFIG_MIPS_BOOT_ENV_LEGACY is not set
CONFIG_MIPS_BOOT_FDT=y
CONFIG_DEBUG_UART=y
CONFIG_FIT=y
CONFIG_BOOTDELAY=3
CONFIG_DEFAULT_FDT_FILE="tplatforms_mrbt1.dtb"
CONFIG_SYS_PROMPT="BAIKAL # "
CONFIG_CMD_CLK=y
CONFIG_CMD_DM=y
CONFIG_CMD_I2C=y
CONFIG_OF_CONTROL=y
CONFIG_DEFAULT_DEVICE_TREE="tplatforms_mrbt1"
CONFIG_DM=y
CONFIG_CLK=y
CONFIG_CLK_BAIKAL=y
CONFIG_DM_I2C=y
CONFIG_SYS_I2C_DW=y
CONFIG_MISC=y
CONFIG_I2C_EEPROM=y
CONFIG_SPECIFY_CONSOLE_INDEX=y
CONFIG_DM_SERIAL=y
CONFIG_SERIAL_RX_BUFFER=y
CONFIG_DEBUG_UART_SHIFT=2
CONFIG_SYS_NS16550=y
CONFIG_ENV_OFFSET=0xe0000
CONFIG_ENV_SIZE=0x10000
CONFIG_ENV_SECT_SIZE=0x10000
CONFIG_CLOCKS_IN_MHZ=CONFIG_SYS_CLK_FREQ / 1000000
CONFIG_WATCHDOG_AUTOSTART=n
```

## configs/tplatforms_sbc101_defconfig
```kconfig
CONFIG_SYS_EXTRA_OPTIONS="SYS_LITTLE_ENDIAN"
CONFIG_MIPS=y
CONFIG_SYS_CONFIG_NAME="tplatforms_sbc101"
CONFIG_TARGET_BAIKAL_MIPS=y
CONFIG_TPLATFORMS_SBC101=y
CONFIG_BAIKAL_T1=y
CONFIG_TUNE_P5600=y
CONFIG_USE_HARD_FLOAT=y
CONFIG_CUSTOM_SPD=y
CONFIG_CUSTOM_SPD_FILE="MT41K512M8"
```
